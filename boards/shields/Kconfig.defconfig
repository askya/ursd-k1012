## boards/shields/Kconfig.shield
```kconfig
config SHIELD_K1012
    def_bool $(shields_list_contains,k1012)
    select ADC
    select GPIO
```

## config/west.yml
```yaml
manifest:
  defaults:
    revision: main
  remotes:
    - name: zmkfirmware
      url-base: https://github.com/zmkfirmware
    # Additional modules containing boards/shields/custom code can be listed here as well
    # See https://docs.zephyrproject.org/3.2.0/develop/west/manifest.html#projects
    - name: zephyrprojectrtos
      url-base: https://github.com/zephyrproject-rtos
  projects:
    - name: zmk
      remote: zmkfirmware
      import: app/west.yml
      revision: main
    - name: zephyr
      remote: zephyrprojectrtos
      revision: v4.1.0
      import: true

  self:
    path: config
```
